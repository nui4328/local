void check_colorCan()
  {
    if(analogRead(28) > 1500)
      {
        col_can = 1;
      }
    else
      {
        col_can = 0;
      }
    if(col_can == col_floor)
      {
        mision_L();
        ch_tlr = 0;
      }
    else
      {
        mision_R();
        ch_tlr = 1;
      }
    
  }

void start_game_random()   // ออกจากจุดปล่อยตัว วิ่งไปเก็บค่าสีของพื้นแรก
  {
    Motor(50, 50); delay(100);   ///////////////////////////เดินออกจากพื้นปล่อยตัว วิ่งเข้าพื้นเก็บค่าสี  เก็บข้างไหนก็ได้

    /////////////////////////////////////////////// ส่วนที่แก้ไข เดินจากปล่อยตัว ถึงเลี้ยวเข้ากรอบ
    fline(60,60, 0.8, 100, 'f', 'r',100, "a4", 0);
    fline(60,60, 0.8, 300, 'n', 's',80, "a4", 1);
    fline_2sensor(65, 65, 0.2, 0, "3:4","a7", 's', 0);
    fline(0,0, 0.8, 10, 'f', 'r',90, "a4", 10);
     
    ///////////////////////////////////////////////
    
    fline_2sensor(35, 35, 0.8, 0, "3:4","a7", 's', 30);  ////เดินเข้าหากรอบ
    Motor(30, 30);delay(100);
    Motor(1, 1);delay(100);
    /////////////////////////////////////////////////////////// เก็บค่าพื้น
    if(mcp_f(7) >= md_mcp_f(7))
      {
          col_floor = 1;
          rgb(1, 1, 1);
          bz(50);
      }
    else
      {
          col_floor = 0;
          rgb(0, 0, 0);
          bz(50);
          bz(50);
      }
    //////////////////////////////////////////////////////////////////////////// แก้  ออกมาจุดเริ่มต้นเก็บกระป๋อง
     bline(60,60, 0.4, 0, 'f', 's',60, "a5", 20);
     bline(70,70, 0.0, 0, 'c', 'r',80, "a5", 20);
   
    ///////////////////////////////////////////////////////////////////////////
   
    }
